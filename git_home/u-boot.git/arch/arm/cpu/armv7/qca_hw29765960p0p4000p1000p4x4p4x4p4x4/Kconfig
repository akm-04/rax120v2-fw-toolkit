## git_home/u-boot.git/arch/arm/cpu/armv7/qca_hw29765960p0p4000p1000p4x4p4x4p4x4/Kconfig
```kconfig
if TARGET_HW29765960P0P4000P1000P4X4P4X4P4X4

config QCA_COMMON
	bool "QCA Common IPs"

endif
```

## git_home/u-boot.git/arch/arm/cpu/armv7/qca_hw29766094p0p256p512p2x2p2x2/Kconfig
```kconfig
if TARGET_HW29766094P0P256P512P2X2P2X2

config QCA_COMMON
	bool "QCA Common IPs"

endif
```

## git_home/u-boot.git/arch/arm/cpu/armv7/qca_hw29766097p0p512p1024p2x2p2x2p2x2/Kconfig
```kconfig
if TARGET_HW29766097P0P512P1024P2x2P2x2P2x2

config QCA_COMMON
	bool "QCA Common IPs"

endif
```

## git_home/u-boot.git/board/qca/hw29765960p0p4000p1000p4x4p4x4p4x4/Kconfig
```kconfig
if TARGET_HW29765960P0P4000P1000P4X4P4X4P4X4

config SYS_BOARD
	default "hw29765960p0p4000p1000p4x4p4x4p4x4"

config SYS_VENDOR
	default "qca"

config SYS_SOC
	default "qca_hw29765960p0p4000p1000p4x4p4x4p4x4"

config SYS_CONFIG_NAME
	default "hw29765960p0p4000p1000p4x4p4x4p4x4"

config IPQ807x_I2C
	bool "Enable i2c support for ipq807x"

config USB_XHCI_IPQ
	bool "ipq807x usb support for ipq807x"

config PCI_IPQ
	bool "ipq807x pci support for ipq807x"

config QCA_AQUANTIA_PHY
	bool "Enable Aquantia PHY support for ipq807x"

config QCA8033_PHY
	bool "Enable QCA8033 PHY support for ipq807x"

config QCA8081_PHY
	bool "Enable QCA8081 PHY support for ipq807x"

config QCA8075_PHY
	bool "Enable QCA8075 PHY support for ipq807x"

endif
```

## git_home/u-boot.git/board/qca/hw29766097p0p512p1024p2x2p2x2p2x2/Kconfig
```kconfig
if TARGET_HW29766097P0P512P1024P2x2P2x2P2x2

config SYS_BOARD
	default "hw29766097p0p512p1024p2x2p2x2p2x2"

config SYS_VENDOR
	default "qca"

config SYS_SOC
	default "qca_hw29766097p0p512p1024p2x2p2x2p2x2"

config SYS_CONFIG_NAME
	default "hw29766097p0p512p1024p2x2p2x2p2x2"

config IPQ807x_I2C
	bool "Enable i2c support for ipq807x"

config USB_XHCI_IPQ
	bool "ipq807x usb support for ipq807x"

config PCI_IPQ
	bool "ipq807x pci support for ipq807x"

config QCA_AQUANTIA_PHY
	bool "Enable Aquantia PHY support for ipq807x"

config QCA8033_PHY
	bool "Enable QCA8033 PHY support for ipq807x"

config QCA8081_PHY
	bool "Enable QCA8081 PHY support for ipq807x"

config QCA8075_PHY
	bool "Enable QCA8075 PHY support for ipq807x"

endif
```

## git_home/u-boot.git/board/qca/hw29766193p0p256p512p2x2p2x2/Kconfig
```kconfig
if TARGET_HW29766193P0P256P512P2X2P2X2

config SYS_CPU
       default "ipq6018"

config SYS_BOARD
       default "hw29766193p0p256p512p2x2p2x2"

config SYS_VENDOR
       default "qca"

config SYS_CONFIG_NAME
       default "hw29766193p0p256p512p2x2p2x2"

config USB_XHCI_IPQ
       bool "Enable usb support for ipq6018"

config PCI_IPQ
       bool "Enable pci support for ipq6018"

config IPQ6018_QCA_AQUANTIA_PHY
       bool "Enable Aquantia PHY support for ipq6018"

config SYS_SOC
       default "qca_hw29766193p0p256p512p2x2p2x2"

config IPQ807x_I2C
	bool "Enable i2c support for ipq807x"

config USB_XHCI_IPQ
	bool "ipq807x usb support for ipq807x"

config PCI_IPQ
	bool "ipq807x pci support for ipq807x"

config QCA_AQUANTIA_PHY
	bool "Enable Aquantia PHY support for ipq807x"

config QCA8033_PHY
	bool "Enable QCA8033 PHY support for ipq807x"

config QCA8081_PHY
	bool "Enable QCA8081 PHY support for ipq807x"

config QCA8075_PHY
	bool "Enable QCA8075 PHY support for ipq807x"

endif
```
